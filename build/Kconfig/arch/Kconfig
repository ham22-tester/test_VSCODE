## build/Kconfig/arch/Kconfig
```kconfig
# Load Zephyr Arch Kconfig descriptions.
osource "C:/Users/iseon/OneDrive/Desktop/zephyr/arch/x86/Kconfig"
osource "C:/Users/iseon/OneDrive/Desktop/zephyr/arch/xtensa/Kconfig"
osource "C:/Users/iseon/OneDrive/Desktop/zephyr/arch/sparc/Kconfig"
osource "C:/Users/iseon/OneDrive/Desktop/zephyr/arch/riscv/Kconfig"
osource "C:/Users/iseon/OneDrive/Desktop/zephyr/arch/posix/Kconfig"
osource "C:/Users/iseon/OneDrive/Desktop/zephyr/arch/nios2/Kconfig"
osource "C:/Users/iseon/OneDrive/Desktop/zephyr/arch/mips/Kconfig"
osource "C:/Users/iseon/OneDrive/Desktop/zephyr/arch/arm64/Kconfig"
osource "C:/Users/iseon/OneDrive/Desktop/zephyr/arch/arm/Kconfig"
osource "C:/Users/iseon/OneDrive/Desktop/zephyr/arch/arc/Kconfig"
```

## build/Kconfig/boards/Kconfig
```kconfig
# Load Zephyr board Kconfig descriptions.
osource "C:/Users/iseon/OneDrive/Desktop/zmk/app/module/boards/nicekeyboards/nice_nano/Kconfig"
osource "C:/Users/iseon/OneDrive/Desktop/zmk/app/boards/nicekeyboards/nice_nano/Kconfig"
```

## build/Kconfig/boards/Kconfig.defconfig
```kconfig
# Load Zephyr board defconfig descriptions.
osource "C:/Users/iseon/OneDrive/Desktop/zmk/app/module/boards/nicekeyboards/nice_nano/Kconfig.defconfig"
osource "C:/Users/iseon/OneDrive/Desktop/zmk/app/boards/nicekeyboards/nice_nano/Kconfig.defconfig"
```

## build/Kconfig/boards/Kconfig.nice_nano
```kconfig
# Load board Kconfig descriptions.
osource "C:/Users/iseon/OneDrive/Desktop/zmk/app/module/boards/nicekeyboards/nice_nano/Kconfig.nice_nano"
osource "C:/Users/iseon/OneDrive/Desktop/zmk/app/boards/nicekeyboards/nice_nano/Kconfig.nice_nano"
```

## build/Kconfig/boards/Kconfig.sysbuild
```kconfig
# Load Sysbuild board Kconfig descriptions.
osource "C:/Users/iseon/OneDrive/Desktop/zmk/app/module/boards/nicekeyboards/nice_nano/Kconfig.sysbuild"
osource "C:/Users/iseon/OneDrive/Desktop/zmk/app/boards/nicekeyboards/nice_nano/Kconfig.sysbuild"
```

## config/boards/shields/tca9555_keyboard/Kconfig.defconfig
```kconfig
if SHIELD_TCA9555_KEYBOARD

config ZMK_KEYBOARD_NAME
    default "TCA9555 Keyboard"

endif
```

## config/boards/shields/tca9555_keyboard/Kconfig.shield
```kconfig
config SHIELD_TCA9555_KEYBOARD
    def_bool $(shields_list_contains,tca9555_keyboard)
```
